## tooling/subsystem/guest/package/ps5term-agent/Config.in
```kconfig
config BR2_PACKAGE_PS5TERM_AGENT
	bool "ps5term-agent"
	help
	  Gives SSH sessions independent PTYs inside the guest over a dedicated
	  virtio console. No sockets or host file access.
```

## tooling/subsystem/guest/ps5term_defconfig
```kconfig
BR2_riscv=y
BR2_RISCV_ISA_RVC=y
BR2_TOOLCHAIN_BUILDROOT_MUSL=y
BR2_PACKAGE_HOST_LINUX_HEADERS_CUSTOM_6_12=y
BR2_REPRODUCIBLE=y
BR2_ENABLE_LOCALE_PURGE=y
BR2_ENABLE_LOCALE_WHITELIST="C en_US"
BR2_TARGET_GENERIC_HOSTNAME="ps5term-linux"
BR2_TARGET_GENERIC_ISSUE="PS5Term Linux guest - isolated development environment"
BR2_TARGET_GENERIC_GETTY_PORT="hvc0"
BR2_TARGET_GENERIC_GETTY_TERM="xterm-256color"
BR2_TARGET_GENERIC_GETTY_OPTIONS="-n -l /usr/bin/ps5term-login"
BR2_ROOTFS_OVERLAY="$(BR2_EXTERNAL_PS5TERM_PATH)/overlay"
BR2_LINUX_KERNEL=y
BR2_LINUX_KERNEL_USE_CUSTOM_CONFIG=y
BR2_LINUX_KERNEL_CUSTOM_CONFIG_FILE="$(BR2_EXTERNAL_PS5TERM_PATH)/linux.config"
BR2_LINUX_KERNEL_IMAGE=y
BR2_PACKAGE_BUSYBOX_CONFIG_FRAGMENT_FILES="$(BR2_EXTERNAL_PS5TERM_PATH)/busybox.config"
BR2_PACKAGE_NCURSES=y
BR2_PACKAGE_NCURSES_WCHAR=y
BR2_PACKAGE_NCURSES_TARGET_PROGS=y
BR2_PACKAGE_NCURSES_ADDITIONAL_TERMINFO="x/xterm-256color s/screen-256color t/tmux-256color"
BR2_PACKAGE_LESS=y
BR2_PACKAGE_E2FSPROGS=y
BR2_PACKAGE_E2FSPROGS_RESIZE2FS=y
# HTTPS downloads with a verified certificate store.
BR2_PACKAGE_MBEDTLS=y
BR2_PACKAGE_LIBCURL=y
BR2_PACKAGE_LIBCURL_CURL=y
BR2_PACKAGE_LIBCURL_MBEDTLS=y
BR2_PACKAGE_CA_CERTIFICATES=y
# Everyday terminal tools: editor, multiple shells, process view, JSON, listing.
BR2_PACKAGE_NANO=y
BR2_PACKAGE_TMUX=y
BR2_PACKAGE_HTOP=y
BR2_PACKAGE_JQ=y
BR2_PACKAGE_TREE=y
BR2_PACKAGE_PS5TERM_AGENT=y
BR2_TARGET_ROOTFS_EXT2=y
BR2_TARGET_ROOTFS_EXT2_2r1=y
BR2_TARGET_ROOTFS_EXT2_SIZE="16M"
# BR2_TARGET_ROOTFS_TAR is not set
BR2_TARGET_OPENSBI=y
BR2_TARGET_OPENSBI_PLAT="generic"
# BR2_TARGET_OPENSBI_INSTALL_DYNAMIC_IMG is not set
BR2_TARGET_OPENSBI_ADDITIONAL_VARIABLES="FW_TEXT_START=0x80000000 FW_JUMP_ADDR=0x80200000"
```
